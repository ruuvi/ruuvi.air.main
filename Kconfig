## dts/bindings/sensor/ti,opt4060.yaml
```yaml
# Copyright (c) 2024, Ruuvi Innovations Ltd
# SPDX-License-Identifier: BSD-3-Clause

description: Texas Instruments OPT4060 RGBW Color Sensor

compatible: "ti,opt4060"

include: [sensor-device.yaml, i2c-device.yaml]

properties:
  irq-gpios:
    type: phandle-array
    description: |
      The INT signal connection. This signal is active-low as produced by the sensor.
```

## tests/unity/test_example1/testcase.yaml
```yaml
tests:
  unity.test_example1:
    sysbuild: true
    tags: example sysbuild
    integration_platforms:
      - native_sim
      - native_sim/native/64
      - nrf52840dk/nrf52840
      - ruuvi_ruuviair/nrf52840
    platform_allow:
      - native_sim
      - native_sim/native/64
      - nrf52840dk/nrf52840
      - ruuvi_ruuviair/nrf52840
    # filter: unity
    build_only: false
```

## tests/ztest/test_draw_plot_dsp_filter_a_weighting/testcase.yaml
```yaml
tests:
  ztest.test_draw_plot_dsp_filter_a_weighting:
    sysbuild: true
    timeout: 10
    tags: example sysbuild
    integration_platforms:
      - native_sim
    platform_allow:
      - native_sim
    build_only: False
    harness: ztest
```

## tests/ztest/test_dsp/Kconfig
```kconfig
# Copyright (c) 2024, Ruuvi Innovations Ltd
# SPDX-License-Identifier: BSD-3-Clause

mainmenu "Test DSP algorithms"

menu "Unit test configuration"

config UUT_PARAM_CHECK
	bool "Enabled function parameter check"

endmenu

source "Kconfig.zephyr"
```

## tests/ztest/test_example2/testcase.yaml
```yaml
tests:
  ztest.test_example2:
    sysbuild: true
    timeout: 10
    tags: example sysbuild
    integration_platforms:
      - native_sim
      - native_sim/native/64
      - nrf52840dk_ruuviair/nrf52840
      - ruuvi_ruuviair/nrf52840
    platform_allow:
      - native_sim
      - native_sim/native/64
      - nrf52840dk_ruuviair/nrf52840
      - ruuvi_ruuviair/nrf52840
#    filter: ztest
    build_only: False
    harness: ztest
```

## tests/ztest/test_led/testcase.yaml
```yaml
tests:
  ztest.test_led:
    sysbuild: true
    timeout: 10
    tags: example sysbuild
    integration_platforms:
      - nrf52840dk/nrf52840
      - ruuvi_ruuviair/nrf52840
    platform_allow:
      - nrf52840dk/nrf52840
      - ruuvi_ruuviair/nrf52840
    build_only: False
    harness: ztest
```

## tests/ztest/test_moving_avg/testcase.yaml
```yaml
tests:
  ztest.test_moving_avg:
    sysbuild: true
    timeout: 10
    tags: example sysbuild
    integration_platforms:
      - native_sim
      - native_sim/native/64
      - nrf52840dk/nrf52840
      - ruuvi_ruuviair/nrf52840
    platform_allow:
      - native_sim
      - native_sim/native/64
      - nrf52840dk/nrf52840
      - ruuvi_ruuviair/nrf52840
    build_only: False
    harness: ztest
```

## tests/ztest/test_spl_calc/testcase.yaml
```yaml
tests:
  ztest.test_spl_calc:
    sysbuild: true
    timeout: 35
    tags: example sysbuild
    integration_platforms:
      - native_sim
      - native_sim/native/64
      - nrf52840dk_ruuviair/nrf52840
      - ruuvi_ruuviair/nrf52840
    platform_allow:
      - native_sim
      - native_sim/native/64
      - nrf52840dk_ruuviair/nrf52840
      - ruuvi_ruuviair/nrf52840
    build_only: False
    harness: ztest
```

## west.yml
```yaml
manifest:
  self:
    path: ruuvi.air
  remotes:
    - name: nrf
      url-base: https://github.com/nrfconnect
  projects:
    - name: sdk-nrf
      remote: nrf
      path: nrf
      revision: v2.9.2
      import: true
      clone-depth: 1
```
