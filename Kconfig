## Kconfig
```kconfig
# Copyright (c) 2024, Ruuvi Innovations Ltd
# SPDX-License-Identifier: BSD-3-Clause

source "Kconfig" # Include Zephyr's main Kconfig
rsource "drivers/Kconfig"

config RUUVI_AIR_BUTTON_DELAY_BEFORE_REBOOT
	int "Delay in ms before reboot after pressing the pinhole button"
	default 5000
	help
	  Delay in ms before reboot after pressing the pinhole button.

choice RUUVI_AIR_PINHOLE_LED
    prompt "Configure pinhole Red/Green LEDs mode"
    default RUUVI_AIR_PINHOLE_LED_PWM
    help
      Select pinhole LED mode for Ruuvi Air.

config RUUVI_AIR_PINHOLE_LED_GPIO
	bool "Use GPIO to control pinhole Red/Green LEDs"

config RUUVI_AIR_PINHOLE_LED_PWM
	bool "Use PWM to control pinhole Red/Green LEDs"

config RUUVI_AIR_PINHOLE_LED_NONE
	bool "Don't use pinhole Red/Green LEDs"

endchoice  # RUUVI_AIR_PINHOLE_LED

config RUUVI_AIR_PINHOLE_LED_PWM_PERIOD_NS
	int "Pinhole LED PWM period (ns)"
	default 20000
	depends on RUUVI_AIR_PINHOLE_LED_PWM
	help
	  PWM period for the bottom LED in nanoseconds.

config RUUVI_AIR_PINHOLE_LED_PWM_PULSE_WIDTH_NS
	int "Pinhole LED PWM pulse width (ns)"
	default 1000
	depends on RUUVI_AIR_PINHOLE_LED_PWM
	help
	  PWM pulse width for the bottom LED in nanoseconds.

config RUUVI_AIR_LED_DIMMING_INTERVAL_MS
	int "LED dimming interval (ms)"
	default 250
	help
	  LED dimming interval in milliseconds.

config RUUVI_AIR_EXPOSE_SERIAL_NUMBER_TIMEOUT_SECS
	int "Expose serial number timeout on button press (seconds)"
	default 60
	help
	  Timeout for exposing the device serial number on button press.


choice RUUVI_AIR_LED_MODE
    prompt "Configure LED mode"
    default RUUVI_AIR_LED_MODE_AQI
    help
      Select LED mode for Ruuvi Air.

config RUUVI_AIR_LED_MODE_AQI
	bool "Use LED to indicate Air Quality Index (AQI)"

config RUUVI_AIR_LED_MODE_CALIBRATE
	bool "Cycle LED to perform calibration"

config RUUVI_AIR_LED_MODE_TEST_RGBW
	bool "Cycle LED through RGBW colors to test functionality"

config RUUVI_AIR_LED_MODE_DISABLED
	bool "Disable LED functionality"

endchoice  # RUUVI_AIR_LED_MODE

config RUUVI_AIR_LED_BRIGHTNESS
	int "LED brightness level"
	default 25
	help
	  LED brightness level (0-255).

config RUUVI_AIR_SENSORS_POLL_CYCLE_MS
	int "Sensor polling cycle in milliseconds"
	default 1000
	help
	  Sensor polling cycle in milliseconds.


config RUUVI_AIR_USE_SENSOR_SEN66
	bool "Enable use of SEN66 sensor for air quality measurements"
	default y


config RUUVI_AIR_USE_SENSOR_DPS310
	bool "Enable use of DPS310 sensor for air pressure and temperature measurements"
	default y


config RUUVI_AIR_USE_SENSOR_OPT4060
	bool "Enable use of OPT4060 sensor for ambient light measurements"
	default y

config RUUVI_AIR_SEN66_VOC_ALG_TUNING_PARAMS_LEARNING_TIME_OFFSET_HOURS
	int "SEN66 VOC algorithm learning time offset (hours)"
	default 12
	help
	  Time constant to estimate the VOC algorithm offset from the history in hours.
	  Past events will be forgotten after about twice the learning time.
	  Allowed values are in range 1..1000.

config RUUVI_AIR_SEN66_VOC_ALG_TUNING_PARAMS_LEARNING_TIME_GAIN_HOURS
	int "SEN66 VOC algorithm learning time gain (hours)"
	default 12
	help
	  Time constant to estimate the VOC algorithm gain from the history in hours.
	  Past events will be forgotten after about twice the learning time.
	  Allowed values are in range 1..1000.

config RUUVI_AIR_SEN66_VOC_ALG_STATE_SAVING_INTERVAL
	int "SEN66 VOC algorithm state saving interval (seconds)"
	default 10
	help
	  Interval at which the VOC algorithm state is saved to persistent storage.
	  Allowed values are in range 0..3600.

config RUUVI_AIR_SEN66_VOC_ALG_STATE_RECOVERY_TIMEOUT
	int "SEN66 VOC algorithm state recovery timeout (seconds)"
	default 900
	help
	  Maximum age of the VOC algorithm state that can be recovered from persistent storage.
	  If the saved state is older than this value, it will be ignored.
	  Allowed values are in range 1..86400.

config RUUVI_AIR_SEN66_NOX_CALIBRATION_TIMEOUT
	int "SEN66 NOx calibration timeout (seconds)"
	default 21600
	help
	  Timeout for the SEN66 NOx sensor calibration process in seconds.

config RUUVI_AIR_OPT4060_LUMINOSITY_MULTIPLIER
	int "OPT4060 luminosity multiplier"
	default 310
	help
	  Multiplier for luminosity value read from OPT4060 sensor.

config RUUVI_AIR_OPT4060_NUM_MEASUREMENTS_PER_SECOND
	int "Number of OPT4060 measurements per second"
	default 50
	help
	  Number of OPT4060 measurements per second.

config RUUVI_AIR_OPT4060_LUMINOSITY_AVG_PERIOD
	int "Moving average period for OPT4060 luminosity (seconds)"
	default 10
	help
	  Moving average period for OPT4060 luminosity readings.

config RUUVI_AIR_ENABLE_HIST_LOG
	bool "Enable logging of sensor data to flash memory"
	default y


config RUUVI_AIR_USE_BLE
	bool "Enable Bluetooth Low Energy (BLE) functionality"
	default y


config RUUVI_AIR_USE_BLE_ADV_NORMAL
	bool "Enable legacy BLE advertising"
	default y


config RUUVI_AIR_USE_BLE_ADV_EXTENDED
	bool "Enable extended BLE advertising"
	default y


config RUUVI_AIR_USE_BLE_ADV_CODED
	bool "Enable coded BLE advertising"
	default y


config RUUVI_AIR_ENABLE_BLE_LOGGING
	bool "Enable logging over BLE"
	default n


config RUUVI_AIR_LOG_TIME
	bool "Log time on every polling cycle"
	default y


choice RUUVI_AIR_MIC
    prompt "Microphone"
    default RUUVI_AIR_MIC_NONE
    help
      Select microphone to be used by Ruuvi Air.

config RUUVI_AIR_MIC_NONE
	bool "No microphone"

config RUUVI_AIR_MIC_SPG08P4HM4H
	bool "Use SPG08P4HM4H"

endchoice

config RUUVI_AIR_MIC_PDM_THREAD_PRIORITY
	int "Thread priority"
	default 11
	help
	  Priority of thread used by the driver to handle interrupts.

config RUUVI_AIR_MIC_PDM_THREAD_STACK_SIZE
	int "Thread stack size"
	default 4096
	help
	  Stack size of thread used by the driver to handle interrupts.

config RUUVI_AIR_MIC_PDM_SAMPLE_RATE
	int "Sample rate"
	default 16000
	help
	  Sample rate of the microphone.

config RUUVI_AIR_NUS_THREAD_PRIORITY
	int "Thread priority"
	default 12
	help
	  Priority of NUS thread.

config RUUVI_AIR_NUS_THREAD_STACK_SIZE
	int "Thread stack size"
	default 4096
	help
	  Stack size of NUS thread.

config RUUVI_AIR_OPT_RGB_CTRL_THREAD_PRIORITY
	int "Thread priority"
	default -16  # The highest cooperative priority (CONFIG_NUM_COOP_PRIORITIES)
	help
	  Priority of opt_rgb_ctrl thread.

config RUUVI_AIR_OPT_RGB_CTRL_THREAD_STACK_SIZE
	int "Thread stack size"
	default 3072
	help
	  Stack size of opt_rgb_ctrl thread.
```

## boards/nordic/nrf52840dk_ruuviair/Kconfig.nrf52840dk_ruuviair
```kconfig
# Copyright (c) 2022 Zephyr Project members and individual contributors
# SPDX-License-Identifier: Apache-2.0

config BOARD_NRF52840DK_RUUVIAIR
	select SOC_NRF52840_QIAA if BOARD_NRF52840DK_RUUVIAIR_NRF52840

config BOARD_RUUVI_RUUVIAIR_REV_1
    bool "RuuviAir v1"
    default y if BOARD_REVISION = "1"

config BOARD_RUUVI_RUUVIAIR_REV_2
    bool "RuuviAir v2"
    default y if BOARD_REVISION = "2"
```

## boards/nordic/nrf52840dk_ruuviair/board.yml
```yaml
board:
  name: nrf52840dk_ruuviair
  vendor: nordic
  revision:
    format: number
    default: "2"
    exact: true
    revisions:
      - name: "1"
      - name: "2"    
  socs:
  # Physical nRF52840 SoC on PCA10056
  - name: nrf52840
```

## boards/nordic/nrf52840dk_ruuviair/nrf52840dk_ruuviair_nrf52840_1_defconfig
```kconfig
# Select the LFCLK source.
# Use the external low-frequency oscillator (LFXO)
CONFIG_CLOCK_CONTROL_NRF_K32SRC_XTAL=y
```

## boards/ruuvi/ruuviair/Kconfig.defconfig
```kconfig
# Ruuvi RuuviAir configuration

# Copyright (c) 2025 Ruuvi Innovations Ltd (Oy)
# SPDX-License-Identifier: Apache-2.0

if BOARD_RUUVI_RUUVIAIR

config BT_CTLR
	default BT

endif # BOARD_RUUVI_RUUVIAIR
```

## boards/ruuvi/ruuviair/Kconfig.ruuvi_ruuviair
```kconfig
# Copyright (c) 2025 Ruuvi Innovations Ltd (Oy)
# SPDX-License-Identifier: Apache-2.0

config BOARD_RUUVI_RUUVIAIR
	select SOC_NRF52840_QFAA

config BOARD_RUUVI_RUUVIAIR_REV_1
    bool "RuuviAir v1"
    default y if BOARD_REVISION = "1"

config BOARD_RUUVI_RUUVIAIR_REV_2
    bool "RuuviAir v2"
    default y if BOARD_REVISION = "2"
```

## boards/ruuvi/ruuviair/board.yml
```yaml
board:
  name: ruuvi_ruuviair
  vendor: ruuvi
  revision:
    format: number
    default: "2"
    exact: true
    revisions:
      - name: "1"
      - name: "2"
  socs:
  - name: nrf52840
```

## boards/ruuvi/ruuviair/ruuvi_ruuviair_nrf52840_2_defconfig
```kconfig
# Select the LFCLK source.

# Use the internal high-frequency oscillator (HFXO) to generate a synthesized 32.768 kHz clock.
# CONFIG_CLOCK_CONTROL_NRF_K32SRC_SYNTH=y

# Use the external 32.768 kHz crystal oscillator for LFCLK.
CONFIG_CLOCK_CONTROL_NRF_K32SRC_EXT_FULL_SWING=y
CONFIG_CLOCK_CONTROL_NRF_K32SRC_20PPM=y
```

## drivers/Kconfig
```kconfig
# Ruuvi drivers configuration options

# Copyright (c) 2024, Ruuvi Innovations Ltd
# SPDX-License-Identifier: BSD-3-Clause

menu "Ruuvi Device Drivers"

rsource "opt4060/Kconfig"
rsource "rtc_pcf85263a/Kconfig"
rsource "lp5810/Kconfig"

endmenu
```

## drivers/lp5810/Kconfig
```kconfig
# LP5810 4-Channel RGBW LED Driver configuration options

# Copyright (c) 2025, Ruuvi Innovations Ltd
# SPDX-License-Identifier: BSD-3-Clause

menuconfig LP5810
	bool "LP5810 4-Channel RGBW LED Controller"
	default n
	depends on DT_HAS_TI_LP5810_ENABLED
	select I2C
	help
		Enable driver for the Texas Instruments LP5810 I2C 4-Channel RGBW
		LED controller.

if LP5810

source "subsys/logging/Kconfig.template.log_config"

config LP5810_INIT_PRIORITY
	int "LP5810 initialization priority"
	default 90
	help
	  System initialization priority for LP5810 driver.

config LP5810_EXPONENTIAL_PWM
	bool "Use exponential PWM dimming curve"
	default n
	help
	  Enable exponential PWM dimming curve for LP5810.
	  This allows for smoother brightness transitions.

endif # LP5810
```

## drivers/opt4060/Kconfig
```kconfig
# OPT4060 RGBW Color Sensor configuration options

# Copyright (c) 2024, Ruuvi Innovations Ltd
# SPDX-License-Identifier: BSD-3-Clause

menuconfig OPT4060
	bool "OPT4060 RGBW Color Sensor"
	default y
	depends on DT_HAS_TI_OPT4060_ENABLED
	select I2C
	help
	  Enable driver for OPT4060 RGBW Color sensors.

if OPT4060

choice OPT4060_INT_MODE
	prompt "Interrupt mode"
	default OPT4060_INT_NONE
	help
	  Specify the type of interrupts handling to be used by the driver.

config OPT4060_INT_NONE
	bool "No interrupts"

config OPT4060_INT_GLOBAL_THREAD
	bool "Use global thread"
	depends on GPIO
	select OPT4060_INT

config OPT4060_INT_OWN_THREAD
	bool "Use own thread"
	depends on GPIO
	select OPT4060_INT
endchoice

config OPT4060_THREAD_PRIORITY
	int "Thread priority"
	depends on OPT4060_INT_OWN_THREAD
	default 10
	help
	  Priority of thread used by the driver to handle interrupts.

config OPT4060_THREAD_STACK_SIZE
	int "Thread stack size"
	depends on OPT4060_INT_OWN_THREAD
	default 2048
	help
	  Stack size of thread used by the driver to handle interrupts.

config OPT4060_INT_DATA_READY_FOR_ALL_CHANNELS
	bool "Data ready interrupt for all channels or each channel"
	depends on OPT4060_INT
	default y
	help
	  Set to 'y' if the data ready interrupt should be generated after conversion of all channels,
	  otherwise generate interrupt after convertsion of each channel.

config OPT4060_OP_MODE_ONESHOT
	bool "One-shot mode"
	default n
	help
	  Set to 'y' if the sensor should operate in one-shot mode, otherwise in continuous mode.

config OPT4060_OP_MODE_ONE_SHOT_FORCED_AUTO_RANGE
	bool "Forced auto-range one-shot mode"
	default n
	help
	  Every one shot trigger forces a full reset on auto-ranging control logic and
	  a fresh auto-range detection in initiated ignoring the previous measurements.

choice OPT4060_RANGE
	prompt "Light range selection"
	default OPT4060_RANGE_AUTO
	help
	  Select the light range of the sensor.
	  Supported values:
	  auto, 2254 lux, 4509 lux, 9018 lux, 18036 lux, 36071 lux, 72142 lux, 144284 lux.

config OPT4060_RANGE_AUTO
	bool "auto"

config OPT4060_RANGE_2254_LUX
	bool "2254 lux"

config OPT4060_RANGE_4509_LUX
	bool "4509 lux"

config OPT4060_RANGE_9018_LUX
	bool "9018 lux"

config OPT4060_RANGE_18036_LUX
	bool "18036 lux"

config OPT4060_RANGE_36071_LUX
	bool "36071 lux"

config OPT4060_RANGE_72142_LUX
	bool "72142 lux"

config OPT4060_RANGE_144284_LUX
	bool "144284 lux"

endchoice

choice OPT4060_CONV_TIME
	prompt "Conversion time"
	default OPT4060_CONV_TIME_100_MS
	help
	  Select conversion time.
	  Supported values:
	  600 us, 1 ms, 1.8 ms, 3.4 ms, 6.5 ms, 12.7 ms, 25 ms, 50 ms, 100 ms, 200 ms, 400 ms, 800 ms.

config OPT4060_CONV_TIME_600_US
	bool "600 us"
config OPT4060_CONV_TIME_1_MS
	bool "1 ms"
config OPT4060_CONV_TIME_1_8_MS
	bool "1.8 ms"
config OPT4060_CONV_TIME_3_4_MS
	bool "3.4 ms"
config OPT4060_CONV_TIME_6_5_MS
	bool "6.5 ms"
config OPT4060_CONV_TIME_12_7_MS
	bool "12.7 ms"
config OPT4060_CONV_TIME_25_MS
	bool "25 ms"
config OPT4060_CONV_TIME_50_MS
	bool "50 ms"
config OPT4060_CONV_TIME_100_MS
	bool "100 ms"
config OPT4060_CONV_TIME_200_MS
	bool "200 ms"
config OPT4060_CONV_TIME_400_MS
	bool "400 ms"
config OPT4060_CONV_TIME_800_MS
	bool "800 ms"
endchoice

config OPT4060_ONE_SHOT_MODE_QUICK_WAKEUP
	bool "Quick wakeup in one shot mode"
	default n
	help
	  Quick Wake-up from Standby in one shot mode by not powering down all circuits.
	  Applicable only in one shot mode and helps get out of standby mode faster
	  with penalty in power consumption compared to full standby mode.

config OPT4060_TRIGGER_DATA_READY
	bool "Trigger data ready"
	default y
	depends on OPT4060_INT
	select OPT4060_TRIGGER
	help
	  Trigger data ready handler when data is ready.

config OPT4060_TRIGGER
	bool

config OPT4060_INT
	bool

endif
```

## drivers/rtc_pcf85263a/Kconfig
```kconfig
# PCF85263A RTC configuration options

# Copyright (c) 2024, Ruuvi Innovations Ltd
# SPDX-License-Identifier: BSD-3-Clause

menuconfig RTC_PCF85263A
	bool "PCF85263A RTC"
	default y
	depends on DT_HAS_NXP_PCF85263A_ENABLED
	select I2C
	help
	  Enable driver for PCF85263A RTC.

if RTC_PCF85263A

config RTC_PCF85263A_INT
	bool "Interrupt mode"
	default y

endif
```

## dts/bindings/led/ti,lp5810.yaml
```yaml
# Copyright (c) 2025, Ruuvi Innovations Ltd
# SPDX-License-Identifier: BSD-3-Clause

description: Texas Instruments LP5810 4-Channel RGBW LED Controller

compatible: "ti,lp5810"

include: ["i2c-device.yaml", "led-controller.yaml"]

properties:
  enable-gpios:
    type: phandle-array
    description: |
      GPIO to use to enable/disable the controller.
  max_curr_opt:
    type: boolean
    description: |
      If enabled the maximum current output is set to 51 mA (25.5 mA else).
  lod_action_cur_out_shutdown:
    type: boolean
    description: |
      If enabled, the controller will shut down current sink when LED open fault happens.
  lsd_action_all_out_shutdown:
    type: boolean
    description: |
      If enabled, the controller will shut down all OUTs when LED short fault happens.
  lsd_threshold:
    type: int
    default: 0
    enum:
      - 0  # LP5810_LSD_THRESHOLD_035_VOUT
      - 1  # LP5810_LSD_THRESHOLD_045_VOUT
      - 2  # LP5810_LSD_THRESHOLD_055_VOUT
      - 3  # LP5810_LSD_THRESHOLD_065_VOUT
    description: |
      LSD (LED Short Detection) threshold voltage setting.
      0: 0.35 * VOUT
      1: 0.45 * VOUT
      2: 0.55 * VOUT
      3: 0.65 * VOUT

child-binding:
  properties:
    label:
      required: true
    index:
      required: true
    color-mapping:
      required: true
```

## dts/bindings/sensor/nxp,pcf85263a.yaml
```yaml
# Copyright (c) 2024, Ruuvi Innovations Ltd
# SPDX-License-Identifier: BSD-3-Clause

description: NXP PCF85263A RTC

compatible: "nxp,pcf85263a"

include: [sensor-device.yaml, i2c-device.yaml]

properties:
  inta-gpios:
    type: phandle-array
    description: |
      The INT signal connection. This signal is active-low as produced by the sensor.
```
