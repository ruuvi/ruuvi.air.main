## CMakeLists.txt
```
#
# Copyright (c) 2019 Nordic Semiconductor
#
# SPDX-License-Identifier: LicenseRef-Nordic-5-Clause
#

cmake_minimum_required(VERSION 3.20.0)

find_package(Zephyr REQUIRED HINTS $ENV{ZEPHYR_BASE})
project(utest_example1)

# generate runner for the test
test_runner_generate(src/example_test.c)

# create mock for foo module. Add header to relative path 'foo'. That is to
# allow including header using <foo/foo.h>
cmock_handle(src/foo/foo.h foo)

# add module foo
target_sources(app PRIVATE src/foo/foo.c)
target_include_directories(app PRIVATE src)

# add module uut
target_sources(app PRIVATE src/uut/uut.c)
target_include_directories(app PRIVATE ./src/uut)

# add test file
target_sources(app PRIVATE src/example_test.c)
target_include_directories(app PRIVATE .)
target_include_directories(app PRIVATE src/foo)

# Preinclude file to the module under test to redefine IS_ENABLED() macro
# which is used in the module.
set_property(SOURCE src/uut/uut.c PROPERTY COMPILE_FLAGS
	"-include src/example_test.h")
```

## prj.conf
```kconfig
#
# Copyright (c) 2019 Nordic Semiconductor ASA
#
# SPDX-License-Identifier: LicenseRef-Nordic-5-Clause
#
CONFIG_UNITY=y
CONFIG_RING_BUFFER=y

# enable to use thread names
CONFIG_THREAD_NAME=y
CONFIG_MP_MAX_NUM_CPUS=1

# Debugging
CONFIG_DEBUG_OPTIMIZATIONS=y
CONFIG_DEBUG_THREAD_INFO=y
```

## src/example_test.c
```c
/*
 * Copyright (c) 2019 Nordic Semiconductor ASA
 *
 * SPDX-License-Identifier: LicenseRef-Nordic-5-Clause
 */
#include <unity.h>
#include <uut.h>
#include <stdbool.h>
#include "foo/cmock_foo.h"

bool runtime_CONFIG_UUT_PARAM_CHECK;

#define TEST_FOO_ADDR FOO_ADDR

void
setUp(void)
{
    runtime_CONFIG_UUT_PARAM_CHECK = false;
}

void
test_uut_init(void)
{
    int err;

    __cmock_foo_init_ExpectAndReturn(NULL, 0);
    __cmock_foo_execute_ExpectAndReturn(0);

    err = uut_init(NULL);
    TEST_ASSERT_EQUAL(0, err);
}

void
test_uut_init_with_param_check(void)
{
    int err;

    /* Enable compile time option to check input parameters. */
    runtime_CONFIG_UUT_PARAM_CHECK = true;

    err = uut_init(NULL);
    TEST_ASSERT_EQUAL(-1, err);
}

/* It is required to be added to each test. That is because unity's
 * main may return nonzero, while zephyr's main currently must
 * return 0 in all cases (other values are reserved).
 */
extern int
unity_main(void);

int
main(void)
{
    (void)unity_main();

    return 0;
}
```
