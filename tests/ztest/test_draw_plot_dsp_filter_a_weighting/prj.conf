## CMakeLists.txt
```
cmake_minimum_required(VERSION 3.20.0)
find_package(Zephyr REQUIRED HINTS $ENV{ZEPHYR_BASE})
project(ztest_draw_plot_dsp_filter_a_weighting)

target_sources(app PRIVATE
        src/test_draw_plot_dsp_filter_a_weighting_16000.c
        src/test_draw_plot_dsp_filter_a_weighting_20828.c
        src/helpers.c
        src/helpers.h
        ../../../src/dsp_biquad_filter_a_weighting_16000.c
        ../../../src/dsp_biquad_filter_a_weighting_16000.h
        ../../../src/dsp_biquad_filter_a_weighting_20828.c
        ../../../src/dsp_biquad_filter_a_weighting_20828.h
        ../../../src/dsp_rms.c
        ../../../src/dsp_rms.h
        ../../../dsp/dsp_arm_biquad_cascade_df1_q15_patched.c
)

target_include_directories(app PRIVATE
        ../../../src
        ../../../dsp
)
```

## Kconfig
```
# Copyright (c) 2024, Ruuvi Innovations Ltd
# SPDX-License-Identifier: BSD-3-Clause

mainmenu "Draw plot DSP filter A-weighting"

source "Kconfig.zephyr"
```

## prj.conf
```kconfig
#
# @copyright Ruuvi Innovations Ltd, license BSD-3-Clause.
#

CONFIG_ZTEST=y

CONFIG_CMSIS_DSP=y
CONFIG_CMSIS_DSP_STATISTICS=y
CONFIG_CMSIS_DSP_FILTERING=y

# enable to use thread names
CONFIG_THREAD_NAME=y
CONFIG_MP_MAX_NUM_CPUS=1

# Debugging
CONFIG_DEBUG_OPTIMIZATIONS=y
CONFIG_DEBUG_THREAD_INFO=y
```

## src/helpers.c
```c
/**
 * @copyright Ruuvi Innovations Ltd, license BSD-3-Clause.
 */

#include "helpers.h"

void
generate_sine_wave(
    float32_t* const p_buffer,
    const uint32_t   buffer_size,
    const float32_t  amplitude,
    const float32_t  frequency,
    const float32_t  phase,
    const uint32_t   sample_rate)
{
    for (uint32_t i = 0; i < buffer_size; i++)
    {
        p_buffer[i] = amplitude
                      * arm_sin_f32(2 * PI * (float32_t)frequency * (float32_t)i / (float)sample_rate + phase);
    }
}

void
convert_float_to_q15(const float32_t* const p_float_buffer, q15_t* const p_q15_buffer, const uint32_t num_samples)
{
    for (uint32_t i = 0; i < num_samples; i++)
    {
        p_q15_buffer[i] = (q15_t)lrintf(p_float_buffer[i] * MAX_Q15);
    }
}
```

## src/helpers.h
```c
/**
 * @copyright Ruuvi Innovations Ltd, license BSD-3-Clause.
 */

#ifndef HELPERS_H
#define HELPERS_H

#include <stdint.h>
#include "arm_math.h"

#ifdef __cplusplus
extern "C" {
#endif

#define MAX_Q15 (32767)

typedef struct filter_a_weighting_result_t
{
    float32_t rms_f32_unfiltered;
    float32_t rms_f32_filtered;
    float32_t rms_q15_filtered_cmsis; // calculated by CMSIS-DSP
    float32_t rms_q15_filtered_patched;
} filter_a_weighting_result_t;

void
generate_sine_wave(
    float32_t* const p_buffer,
    const uint32_t   buffer_size,
    const float32_t  amplitude,
    const float32_t  frequency,
    const float32_t  phase,
    const uint32_t   sample_rate);

void
convert_float_to_q15(const float32_t* const p_float_buffer, q15_t* const p_q15_buffer, const uint32_t num_samples);

#ifdef __cplusplus
}
#endif

#endif // HELPERS_H
```

## src/test_draw_plot_dsp_filter_a_weighting_16000.c
```c
/**
 * @copyright Ruuvi Innovations Ltd, license BSD-3-Clause.
 */

#include <stdint.h>
#include <stddef.h>
#include <stdlib.h>
#include <stdio.h>
#include <assert.h>
#include "dsp_biquad_filter_a_weighting_16000.h"
#include "dsp_rms.h"
#include "zassert.h"
#include "helpers.h"

#define NUM_PLOT_POINTS (200)

#define SAMPLE_RATE           16000
#define BLOCK_DURATION_MS     (20)
#define NUM_BLOCKS_PER_SECOND (1000 / BLOCK_DURATION_MS)
#define NUM_SAMPLES_PER_BLOCK (SAMPLE_RATE / NUM_BLOCKS_PER_SECOND)

static void*
test_setup(void);

static void
test_suite_before(void* f);

static void
test_suite_after(void* f);

static void
test_teardown(void* f);

ZTEST_SUITE(
    test_suite_draw_plot_dsp_filter_a_weighting_16000,
    NULL,
    &test_setup,
    &test_suite_before,
    &test_suite_after,
    &test_teardown);

typedef struct test_suite_draw_plot_dsp_filter_a_weighting_16000_fixture
{
    float32_t in_buf_f32[NUM_SAMPLES_PER_BLOCK];
    q15_t     in_buf_q15[NUM_SAMPLES_PER_BLOCK];
    float32_t out_buf_f32[NUM_SAMPLES_PER_BLOCK];
    q15_t     out_buf_q15[NUM_SAMPLES_PER_BLOCK];
} test_suite_fixture_t;

static void*
test_setup(void)
{
    test_suite_fixture_t* p_fixture = calloc(1, sizeof(*p_fixture));
    assert(NULL != p_fixture);
    return p_fixture;
}

static void
test_suite_before(void* f)
{
    test_suite_fixture_t* p_fixture = f;
    memset(p_fixture, 0, sizeof(*p_fixture));
}

static void
test_suite_after(void* f)
{
}

static void
test_teardown(void* f)
{
    if (NULL != f)
    {
        free(f);
    }
}

static filter_a_weighting_result_t
apply_filter_a_weighting(test_suite_fixture_t* const fixture)
{
    filter_a_weighting_result_t res = { 0 };

    arm_rms_f32(fixture->in_buf_f32, NUM_SAMPLES_PER_BLOCK, &res.rms_f32_unfiltered);

    convert_float_to_q15(fixture->in_buf_f32, fixture->in_buf_q15, NUM_SAMPLES_PER_BLOCK);

    dsp_biquad_cascade_df1_a_weighting_filter_state_f32_t state_f32 = { 0 };

    dsp_biquad_filter_a_weighting_16000_f32(
        &state_f32,
        fixture->in_buf_f32,
        fixture->out_buf_f32,
        NUM_SAMPLES_PER_BLOCK);
    arm_rms_f32(fixture->out_buf_f32, NUM_SAMPLES_PER_BLOCK, &res.rms_f32_filtered);

    dsp_biquad_cascade_df1_a_weighting_filter_state_q15_t state_q15_cmsis = { 0 };

    dsp_biquad_filter_a_weighting_16000_q15_cmsis(
        &state_q15_cmsis,
        fixture->in_buf_q15,
        fixture->out_buf_q15,
        NUM_SAMPLES_PER_BLOCK);
    res.rms_q15_filtered_cmsis = dsp_rms_q15_f32(fixture->out_buf_q15, NUM_SAMPLES_PER_BLOCK) / MAX_Q15;

    dsp_biquad_cascade_df1_a_weighting_filter_state_q15_t state_q15 = { 0 };

    dsp_biquad_filter_a_weighting_16000_q15(
        &state_q15,
        fixture->in_buf_q15,
        fixture->out_buf_q15,
        NUM_SAMPLES_PER_BLOCK);
    res.rms_q15_filtered_patched = dsp_rms_q15_f32(fixture->out_buf_q15, NUM_SAMPLES_PER_BLOCK) / MAX_Q15;

    return res;
}

ZTEST_F(test_suite_draw_plot_dsp_filter_a_weighting_16000, test_draw_plot)
{
    const float    amplitude  = 0.5f;
    const uint32_t num_points = 200;

    const char* filename = "result_16000.csv";
    printf("Create file %s\n", filename);
    FILE* fp = fopen(filename, "w");
    zassert_not_null(fp);
    fprintf(fp, "freq,rms_unfiltered,rms_f32_filtered,rms_q15_filtered_cmsis,rms_q15_filtered_patched\n");

    // Define the range for logarithmic spacing
    const float freq_start = 10;    // 10 Hz
    const float freq_end   = 22000; // 22 kHz
    // Compute evenly spaced logarithmic points
    for (int i = 0; i < num_points; ++i)
    {
        float       fraction = (float)i / (float)(num_points - 1);
        const float freq     = freq_start * powf(freq_end / freq_start, fraction);

        const float rms_unfiltered = amplitude / sqrtf(2.0f);

        generate_sine_wave(fixture->in_buf_f32, NUM_SAMPLES_PER_BLOCK, amplitude, freq, 0, SAMPLE_RATE);
        const filter_a_weighting_result_t res = apply_filter_a_weighting(fixture);

        fprintf(
            fp,
            "%f,%f,%f,%f,%f\n",
            (double)freq,
            (double)rms_unfiltered,
            (double)res.rms_f32_filtered,
            (double)res.rms_q15_filtered_cmsis,
            (double)res.rms_q15_filtered_patched);
    }
}
```

## src/test_draw_plot_dsp_filter_a_weighting_20828.c
```c
/**
 * @copyright Ruuvi Innovations Ltd, license BSD-3-Clause.
 */

#include <stdint.h>
#include <stddef.h>
#include <stdlib.h>
#include <stdio.h>
#include <assert.h>
#include "dsp_biquad_filter_a_weighting_20828.h"
#include "dsp_rms.h"
#include "zassert.h"
#include "helpers.h"

#define NUM_PLOT_POINTS (200)

#define SAMPLE_RATE           20828
#define BLOCK_DURATION_MS     (20)
#define NUM_BLOCKS_PER_SECOND (1000 / BLOCK_DURATION_MS)
#define NUM_SAMPLES_PER_BLOCK (SAMPLE_RATE / NUM_BLOCKS_PER_SECOND)

static void*
test_setup(void);

static void
test_suite_before(void* f);

static void
test_suite_after(void* f);

static void
test_teardown(void* f);

ZTEST_SUITE(
    test_suite_draw_plot_dsp_filter_a_weighting_20828,
    NULL,
    &test_setup,
    &test_suite_before,
    &test_suite_after,
    &test_teardown);

typedef struct test_suite_draw_plot_dsp_filter_a_weighting_20828_fixture
{
    float32_t in_buf_f32[NUM_SAMPLES_PER_BLOCK];
    q15_t     in_buf_q15[NUM_SAMPLES_PER_BLOCK];
    float32_t out_buf_f32[NUM_SAMPLES_PER_BLOCK];
    q15_t     out_buf_q15[NUM_SAMPLES_PER_BLOCK];
} test_suite_fixture_t;

static void*
test_setup(void)
{
    test_suite_fixture_t* p_fixture = calloc(1, sizeof(*p_fixture));
    assert(NULL != p_fixture);
    return p_fixture;
}

static void
test_suite_before(void* f)
{
    test_suite_fixture_t* p_fixture = f;
    memset(p_fixture, 0, sizeof(*p_fixture));
}

static void
test_suite_after(void* f)
{
}

static void
test_teardown(void* f)
{
    if (NULL != f)
    {
        free(f);
    }
}

static filter_a_weighting_result_t
apply_filter_a_weighting(test_suite_fixture_t* const fixture)
{
    filter_a_weighting_result_t res = { 0 };

    arm_rms_f32(fixture->in_buf_f32, NUM_SAMPLES_PER_BLOCK, &res.rms_f32_unfiltered);

    convert_float_to_q15(fixture->in_buf_f32, fixture->in_buf_q15, NUM_SAMPLES_PER_BLOCK);

    dsp_biquad_cascade_df1_a_weighting_filter_state_f32_t state_f32 = { 0 };

    dsp_biquad_filter_a_weighting_20828_f32(
        &state_f32,
        fixture->in_buf_f32,
        fixture->out_buf_f32,
        NUM_SAMPLES_PER_BLOCK);
    arm_rms_f32(fixture->out_buf_f32, NUM_SAMPLES_PER_BLOCK, &res.rms_f32_filtered);

    dsp_biquad_cascade_df1_a_weighting_filter_state_q15_t state_q15_cmsis = { 0 };

    dsp_biquad_filter_a_weighting_20828_q15_cmsis(
        &state_q15_cmsis,
        fixture->in_buf_q15,
        fixture->out_buf_q15,
        NUM_SAMPLES_PER_BLOCK);
    res.rms_q15_filtered_cmsis = dsp_rms_q15_f32(fixture->out_buf_q15, NUM_SAMPLES_PER_BLOCK) / MAX_Q15;

    dsp_biquad_cascade_df1_a_weighting_filter_state_q15_t state_q15 = { 0 };

    dsp_biquad_filter_a_weighting_20828_q15(
        &state_q15,
        fixture->in_buf_q15,
        fixture->out_buf_q15,
        NUM_SAMPLES_PER_BLOCK);
    res.rms_q15_filtered_patched = dsp_rms_q15_f32(fixture->out_buf_q15, NUM_SAMPLES_PER_BLOCK) / MAX_Q15;

    return res;
}

ZTEST_F(test_suite_draw_plot_dsp_filter_a_weighting_20828, test_draw_plot)
{
    const float    amplitude  = 0.5f;
    const uint32_t num_points = 200;

    const char* filename = "result_20828.csv";
    printf("Create file %s\n", filename);
    FILE* fp = fopen(filename, "w");
    zassert_not_null(fp);
    fprintf(fp, "freq,rms_unfiltered,rms_f32_filtered,rms_q15_filtered_cmsis,rms_q15_filtered_patched\n");

    // Define the range for logarithmic spacing
    const float freq_start = 10;    // 10 Hz
    const float freq_end   = 22000; // 22 kHz
    // Compute evenly spaced logarithmic points
    for (int i = 0; i < num_points; ++i)
    {
        float       fraction = (float)i / (float)(num_points - 1);
        const float freq     = freq_start * powf(freq_end / freq_start, fraction);

        const float rms_unfiltered = amplitude / sqrtf(2.0f);

        generate_sine_wave(fixture->in_buf_f32, NUM_SAMPLES_PER_BLOCK, amplitude, freq, 0, SAMPLE_RATE);
        const filter_a_weighting_result_t res = apply_filter_a_weighting(fixture);

        fprintf(
            fp,
            "%f,%f,%f,%f,%f\n",
            (double)freq,
            (double)rms_unfiltered,
            (double)res.rms_f32_filtered,
            (double)res.rms_q15_filtered_cmsis,
            (double)res.rms_q15_filtered_patched);
    }
}
```
