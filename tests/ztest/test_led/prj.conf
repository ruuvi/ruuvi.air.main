## CMakeLists.txt
```
cmake_minimum_required(VERSION 3.20.0)
find_package(Zephyr REQUIRED HINTS $ENV{ZEPHYR_BASE})
project(ztest_led)

target_sources(app PRIVATE src/test_led.c ../../../src/app_led.c ../../../src/app_led.h)
target_include_directories(app PRIVATE ../../../include ../../../src)
```

## Kconfig
```
# Copyright (c) 2024, Ruuvi Innovations Ltd
# SPDX-License-Identifier: BSD-3-Clause

mainmenu "Example unity test"

menu "Unit under test configuration"

config UUT_PARAM_CHECK
	bool "Enabled function parameter check"

endmenu

choice RUUVI_AIR_PINHOLE_LED
    prompt "Configure pinhole Red/Green LEDs mode"
    default RUUVI_AIR_PINHOLE_LED_PWM
    help
      Select pinhole LED mode for Ruuvi Air.

config RUUVI_AIR_PINHOLE_LED_GPIO
	bool "Use GPIO to control pinhole Red/Green LEDs"

config RUUVI_AIR_PINHOLE_LED_PWM
	bool "Use PWM to control pinhole Red/Green LEDs"

config RUUVI_AIR_PINHOLE_LED_NONE
	bool "Don't use pinhole Red/Green LEDs"

endchoice  # RUUVI_AIR_PINHOLE_LED

config RUUVI_AIR_PINHOLE_LED_PWM_PERIOD_NS
	int "Pinhole LED PWM period (ns)"
	default 20000
	depends on RUUVI_AIR_PINHOLE_LED_PWM
	help
	  PWM period for the bottom LED in nanoseconds.

config RUUVI_AIR_PINHOLE_LED_PWM_PULSE_WIDTH_NS
	int "Pinhole LED PWM pulse width (ns)"
	default 1000
	depends on RUUVI_AIR_PINHOLE_LED_PWM
	help
	  PWM pulse width for the bottom LED in nanoseconds.


source "Kconfig.zephyr"
```

## prj.conf
```kconfig
#
# @copyright Ruuvi Innovations Ltd, license BSD-3-Clause.
#

CONFIG_ZTEST=y

# enable to use thread names
CONFIG_THREAD_NAME=y
CONFIG_MP_MAX_NUM_CPUS=1

# Debugging
CONFIG_DEBUG_OPTIMIZATIONS=y
CONFIG_DEBUG_THREAD_INFO=y

CONFIG_PWM=y
CONFIG_RUUVI_AIR_PINHOLE_LED_PWM=y
CONFIG_RUUVI_AIR_PINHOLE_LED_PWM_PERIOD_NS=20000
CONFIG_RUUVI_AIR_PINHOLE_LED_PWM_PULSE_WIDTH_NS=1000

CONFIG_DEBUG=y
CONFIG_DEBUG_INFO=y
CONFIG_DEBUG_THREAD_INFO=y
CONFIG_NO_OPTIMIZATIONS=y
CONFIG_EXTRA_EXCEPTION_INFO=y

# add asserts
CONFIG_ASSERT=y
CONFIG_ASSERT_LEVEL=2
CONFIG_ASSERT_VERBOSE=y
CONFIG_ASSERT_NO_COND_INFO=n
CONFIG_ASSERT_NO_FILE_INFO=n
CONFIG_ASSERT_NO_MSG_INFO=n
CONFIG_RESET_ON_FATAL_ERROR=n
```

## src/test_led.c
```c
/**
 * @copyright Ruuvi Innovations Ltd, license BSD-3-Clause.
 */

#include <zephyr/ztest.h>
#include "app_led.h"

ZTEST_SUITE(led_tests, NULL, NULL, NULL, NULL, NULL);

ZTEST(led_tests, test_blinking)
{
    app_led_early_init();

    // LED works in GPIO mode
    for (int i = 0; i < 2; ++i)
    {
        k_msleep(400);
        app_led_green_set(true);
        k_msleep(400);
        app_led_green_set(false);

        k_msleep(400);
        app_led_red_set(true);
        k_msleep(400);
        app_led_red_set(false);
    }

    app_led_late_init_pwm();
    // LED works in PWM mode
    for (int i = 0; i < 2; ++i)
    {
        k_msleep(400);
        app_led_green_set(true);
        k_msleep(400);
        app_led_green_set(false);

        k_msleep(400);
        app_led_red_set(true);
        k_msleep(400);
        app_led_red_set(false);
    }
}
```
